## wlan/wlan_combo/Kconfig
```kconfig
#
# Unisoc Wlan Combo configuration
#
menu "Unisoc Wlan Device Drivers"
config UNISOC_WLAN_COMBO
	tristate "UNISOC_WLAN_COMBO"
	depends on CFG80211
	help
	  This module adds support for Unisoc sc23xx series wcn chipset.
	  The drivers is a fullmac driver, which make use of cfg80211 stack.

	  If you choose to build a module, it will be called sprd_wlan_combo.ko.

config UNISOC_WLAN_DEBUG
	tristate "UNISOC_WLAN_DEBUG"
	default n
	help
	  This config use to control debug functions for wlan.
	  For example,turn on debug message in wlan.debug version will print more log.
	  and cp2 will use some buf that used to send data in use version to store debug info.
	  you need config y in soc_debug.fragment.

endmenu
```
